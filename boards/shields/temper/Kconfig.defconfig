## config/west.yml
```yaml
manifest:
  defaults:
    remote: urob
    revision: v0.3  # Pin modules to v0.3

  remotes:
    - name: zmkfirmware
      url-base: https://github.com/zmkfirmware
    - name: urob
      url-base: https://github.com/urob

  projects:
    - name: zmk
      remote: zmkfirmware
      revision: v0.3.0
      import: app/west.yml
    - name: zmk-adaptive-key
      remote: urob
      path: modules/zmk/adaptive-key
    - name: zmk-auto-layer
      remote: urob
      path: modules/zmk/auto-layer
    - name: zmk-helpers
      remote: urob
      path: modules/zmk/helpers

  self:
    path: config
```
